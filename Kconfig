## Kconfig
```kconfig
# M+++ configuration file

config EXAMPLES_M3P
	bool "M3P"
	default y
	depends on SYSTEM_POPEN && NETUTILS_CJSON
	---help---
		Enable the M3P

if EXAMPLES_M3P

config EXAMPLES_M3P_PROGNAME
	string "Program name"
	default "m3p"

config EXAMPLES_M3P_WIFI_ESSID
	string "network essid"
	default "M3P_WiFi"

config EXAMPLES_M3P_WIFI_PSK
	string "network passkey"
	default "rlkp5309"

config EXAMPLES_M3P_I2C_BUS
	int "I2C BUS port"
	default 0

config EXAMPLES_M3P_PRIORITY
	int "task priority"
	default 100

config EXAMPLES_M3P_STACKSIZE
	int "stack size"
	default 8000

endif
```
